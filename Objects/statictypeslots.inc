/* Generated by statictypeslots.py */
offsetof(PyTypeObject, tp_name),
offsetof(PyTypeObject, tp_basicsize),
offsetof(PyTypeObject, tp_itemsize),
offsetof(PyTypeObject, tp_dealloc),
offsetof(PyTypeObject, tp_vectorcall_offset),
offsetof(PyTypeObject, tp_getattr),
offsetof(PyTypeObject, tp_setattr),
offsetof(PyTypeObject, tp_repr),
offsetof(PyTypeObject, tp_hash),
offsetof(PyTypeObject, tp_call),
offsetof(PyTypeObject, tp_str),
offsetof(PyTypeObject, tp_getattro),
offsetof(PyTypeObject, tp_setattro),
offsetof(PyTypeObject, tp_flags),
offsetof(PyTypeObject, tp_doc),
offsetof(PyTypeObject, tp_traverse),
offsetof(PyTypeObject, tp_clear),
offsetof(PyTypeObject, tp_richcompare),
offsetof(PyTypeObject, tp_weaklistoffset),
offsetof(PyTypeObject, tp_iter),
offsetof(PyTypeObject, tp_iternext),
offsetof(PyTypeObject, tp_methods),
offsetof(PyTypeObject, tp_members),
offsetof(PyTypeObject, tp_getset),
offsetof(PyTypeObject, tp_base),
offsetof(PyTypeObject, tp_dict),
offsetof(PyTypeObject, tp_descr_get),
offsetof(PyTypeObject, tp_descr_set),
offsetof(PyTypeObject, tp_dictoffset),
offsetof(PyTypeObject, tp_init),
offsetof(PyTypeObject, tp_alloc),
offsetof(PyTypeObject, tp_new),
offsetof(PyTypeObject, tp_free),
offsetof(PyTypeObject, tp_is_gc),
offsetof(PyTypeObject, tp_bases),
offsetof(PyTypeObject, tp_mro),
offsetof(PyTypeObject, tp_cache),
offsetof(PyTypeObject, tp_subclasses),
offsetof(PyTypeObject, tp_weaklist),
offsetof(PyTypeObject, tp_del),
offsetof(PyTypeObject, tp_finalize),
offsetof(PyTypeObject, tp_as_async),
offsetof(PyAsyncMethods, am_await),
offsetof(PyAsyncMethods, am_aiter),
offsetof(PyAsyncMethods, am_anext),
offsetof(PyTypeObject, tp_as_number),
offsetof(PyNumberMethods, nb_add),
offsetof(PyNumberMethods, nb_subtract),
offsetof(PyNumberMethods, nb_multiply),
offsetof(PyNumberMethods, nb_remainder),
offsetof(PyNumberMethods, nb_divmod),
offsetof(PyNumberMethods, nb_power),
offsetof(PyNumberMethods, nb_negative),
offsetof(PyNumberMethods, nb_positive),
offsetof(PyNumberMethods, nb_absolute),
offsetof(PyNumberMethods, nb_bool),
offsetof(PyNumberMethods, nb_invert),
offsetof(PyNumberMethods, nb_lshift),
offsetof(PyNumberMethods, nb_rshift),
offsetof(PyNumberMethods, nb_and),
offsetof(PyNumberMethods, nb_xor),
offsetof(PyNumberMethods, nb_or),
offsetof(PyNumberMethods, nb_int),
offsetof(PyNumberMethods, nb_reserved),
offsetof(PyNumberMethods, nb_float),
offsetof(PyNumberMethods, nb_inplace_add),
offsetof(PyNumberMethods, nb_inplace_subtract),
offsetof(PyNumberMethods, nb_inplace_multiply),
offsetof(PyNumberMethods, nb_inplace_remainder),
offsetof(PyNumberMethods, nb_inplace_power),
offsetof(PyNumberMethods, nb_inplace_lshift),
offsetof(PyNumberMethods, nb_inplace_rshift),
offsetof(PyNumberMethods, nb_inplace_and),
offsetof(PyNumberMethods, nb_inplace_xor),
offsetof(PyNumberMethods, nb_inplace_or),
offsetof(PyNumberMethods, nb_floor_divide),
offsetof(PyNumberMethods, nb_true_divide),
offsetof(PyNumberMethods, nb_inplace_floor_divide),
offsetof(PyNumberMethods, nb_inplace_true_divide),
offsetof(PyNumberMethods, nb_index),
offsetof(PyNumberMethods, nb_matrix_multiply),
offsetof(PyNumberMethods, nb_inplace_matrix_multiply),
offsetof(PyTypeObject, tp_as_sequence),
offsetof(PySequenceMethods, sq_length),
offsetof(PySequenceMethods, sq_concat),
offsetof(PySequenceMethods, sq_repeat),
offsetof(PySequenceMethods, sq_item),
offsetof(PySequenceMethods, sq_ass_item),
offsetof(PySequenceMethods, sq_contains),
offsetof(PySequenceMethods, sq_inplace_concat),
offsetof(PySequenceMethods, sq_inplace_repeat),
offsetof(PyTypeObject, tp_as_mapping),
offsetof(PyMappingMethods, mp_length),
offsetof(PyMappingMethods, mp_subscript),
offsetof(PyMappingMethods, mp_ass_subscript),
offsetof(PyTypeObject, tp_as_buffer),
offsetof(PyBufferProcs, bf_getbuffer),
offsetof(PyBufferProcs, bf_releasebuffer),
