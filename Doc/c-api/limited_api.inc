.. File generated by Tools/stable_abi.py

* :c:func:`PyAiter_Check`
* :c:func:`PyArg_Parse`
* :c:func:`PyArg_ParseTuple`
* :c:func:`PyArg_ParseTupleAndKeywords`
* :c:func:`PyArg_UnpackTuple`
* :c:func:`PyArg_VaParse`
* :c:func:`PyArg_VaParseTupleAndKeywords`
* :c:func:`PyArg_ValidateKeywordArguments`
* :c:data:`PyBaseObject_Type`
* :c:func:`PyBool_FromLong`
* :c:data:`PyBool_Type`
* :c:data:`PyByteArrayIter_Type`
* :c:func:`PyByteArray_AsString`
* :c:func:`PyByteArray_Concat`
* :c:func:`PyByteArray_FromObject`
* :c:func:`PyByteArray_FromStringAndSize`
* :c:func:`PyByteArray_Resize`
* :c:func:`PyByteArray_Size`
* :c:data:`PyByteArray_Type`
* :c:data:`PyBytesIter_Type`
* :c:func:`PyBytes_AsString`
* :c:func:`PyBytes_AsStringAndSize`
* :c:func:`PyBytes_Concat`
* :c:func:`PyBytes_ConcatAndDel`
* :c:func:`PyBytes_DecodeEscape`
* :c:func:`PyBytes_FromFormat`
* :c:func:`PyBytes_FromFormatV`
* :c:func:`PyBytes_FromObject`
* :c:func:`PyBytes_FromString`
* :c:func:`PyBytes_FromStringAndSize`
* :c:func:`PyBytes_Repr`
* :c:func:`PyBytes_Size`
* :c:data:`PyBytes_Type`
* :c:type:`PyCFunction`
* :c:type:`PyCFunctionWithKeywords`
* :c:func:`PyCFunction_Call`
* :c:func:`PyCFunction_GetFlags`
* :c:func:`PyCFunction_GetFunction`
* :c:func:`PyCFunction_GetSelf`
* :c:func:`PyCFunction_New`
* :c:func:`PyCFunction_NewEx`
* :c:data:`PyCFunction_Type`
* :c:func:`PyCMethod_New`
* :c:func:`PyCallIter_New`
* :c:data:`PyCallIter_Type`
* :c:func:`PyCallable_Check`
* :c:type:`PyCapsule_Destructor`
* :c:func:`PyCapsule_GetContext`
* :c:func:`PyCapsule_GetDestructor`
* :c:func:`PyCapsule_GetName`
* :c:func:`PyCapsule_GetPointer`
* :c:func:`PyCapsule_Import`
* :c:func:`PyCapsule_IsValid`
* :c:func:`PyCapsule_New`
* :c:func:`PyCapsule_SetContext`
* :c:func:`PyCapsule_SetDestructor`
* :c:func:`PyCapsule_SetName`
* :c:func:`PyCapsule_SetPointer`
* :c:data:`PyCapsule_Type`
* :c:data:`PyClassMethodDescr_Type`
* :c:func:`PyCodec_BackslashReplaceErrors`
* :c:func:`PyCodec_Decode`
* :c:func:`PyCodec_Decoder`
* :c:func:`PyCodec_Encode`
* :c:func:`PyCodec_Encoder`
* :c:func:`PyCodec_IgnoreErrors`
* :c:func:`PyCodec_IncrementalDecoder`
* :c:func:`PyCodec_IncrementalEncoder`
* :c:func:`PyCodec_KnownEncoding`
* :c:func:`PyCodec_LookupError`
* :c:func:`PyCodec_NameReplaceErrors`
* :c:func:`PyCodec_Register`
* :c:func:`PyCodec_RegisterError`
* :c:func:`PyCodec_ReplaceErrors`
* :c:func:`PyCodec_StreamReader`
* :c:func:`PyCodec_StreamWriter`
* :c:func:`PyCodec_StrictErrors`
* :c:data:`PyCodec_Unregister`
* :c:func:`PyCodec_XMLCharRefReplaceErrors`
* :c:func:`PyComplex_FromDoubles`
* :c:func:`PyComplex_ImagAsDouble`
* :c:func:`PyComplex_RealAsDouble`
* :c:data:`PyComplex_Type`
* :c:func:`PyDescr_NewClassMethod`
* :c:func:`PyDescr_NewGetSet`
* :c:func:`PyDescr_NewMember`
* :c:func:`PyDescr_NewMethod`
* :c:data:`PyDictItems_Type`
* :c:data:`PyDictIterItem_Type`
* :c:data:`PyDictIterKey_Type`
* :c:data:`PyDictIterValue_Type`
* :c:data:`PyDictKeys_Type`
* :c:func:`PyDictProxy_New`
* :c:data:`PyDictProxy_Type`
* :c:data:`PyDictRevIterItem_Type`
* :c:data:`PyDictRevIterKey_Type`
* :c:data:`PyDictRevIterValue_Type`
* :c:data:`PyDictValues_Type`
* :c:func:`PyDict_Clear`
* :c:func:`PyDict_Contains`
* :c:func:`PyDict_Copy`
* :c:func:`PyDict_DelItem`
* :c:func:`PyDict_DelItemString`
* :c:func:`PyDict_GetItem`
* :c:func:`PyDict_GetItemString`
* :c:func:`PyDict_GetItemWithError`
* :c:func:`PyDict_Items`
* :c:func:`PyDict_Keys`
* :c:func:`PyDict_Merge`
* :c:func:`PyDict_MergeFromSeq2`
* :c:func:`PyDict_New`
* :c:func:`PyDict_Next`
* :c:func:`PyDict_SetItem`
* :c:func:`PyDict_SetItemString`
* :c:func:`PyDict_Size`
* :c:data:`PyDict_Type`
* :c:func:`PyDict_Update`
* :c:func:`PyDict_Values`
* :c:data:`PyEllipsis_Type`
* :c:data:`PyEnum_Type`
* :c:func:`PyErr_BadArgument`
* :c:func:`PyErr_BadInternalCall`
* :c:func:`PyErr_CheckSignals`
* :c:func:`PyErr_Clear`
* :c:func:`PyErr_Display`
* :c:func:`PyErr_ExceptionMatches`
* :c:func:`PyErr_Fetch`
* :c:func:`PyErr_Format`
* :c:func:`PyErr_FormatV`
* :c:func:`PyErr_GetExcInfo`
* :c:func:`PyErr_GivenExceptionMatches`
* :c:func:`PyErr_NewException`
* :c:func:`PyErr_NewExceptionWithDoc`
* :c:func:`PyErr_NoMemory`
* :c:func:`PyErr_NormalizeException`
* :c:func:`PyErr_Occurred`
* :c:func:`PyErr_Print`
* :c:func:`PyErr_PrintEx`
* :c:func:`PyErr_ProgramText`
* :c:func:`PyErr_ResourceWarning`
* :c:func:`PyErr_Restore`
* :c:func:`PyErr_SetExcFromWindowsErr`
* :c:func:`PyErr_SetExcFromWindowsErrWithFilename`
* :c:func:`PyErr_SetExcFromWindowsErrWithFilenameObject`
* :c:func:`PyErr_SetExcFromWindowsErrWithFilenameObjects`
* :c:func:`PyErr_SetExcInfo`
* :c:func:`PyErr_SetFromErrno`
* :c:func:`PyErr_SetFromErrnoWithFilename`
* :c:func:`PyErr_SetFromErrnoWithFilenameObject`
* :c:func:`PyErr_SetFromErrnoWithFilenameObjects`
* :c:func:`PyErr_SetFromWindowsErr`
* :c:func:`PyErr_SetFromWindowsErrWithFilename`
* :c:func:`PyErr_SetImportError`
* :c:func:`PyErr_SetImportErrorSubclass`
* :c:func:`PyErr_SetInterrupt`
* :c:func:`PyErr_SetInterruptEx`
* :c:func:`PyErr_SetNone`
* :c:func:`PyErr_SetObject`
* :c:func:`PyErr_SetString`
* :c:func:`PyErr_SyntaxLocation`
* :c:func:`PyErr_SyntaxLocationEx`
* :c:func:`PyErr_WarnEx`
* :c:func:`PyErr_WarnExplicit`
* :c:func:`PyErr_WarnFormat`
* :c:func:`PyErr_WriteUnraisable`
* :c:func:`PyEval_AcquireLock`
* :c:func:`PyEval_AcquireThread`
* :c:func:`PyEval_CallFunction`
* :c:func:`PyEval_CallMethod`
* :c:func:`PyEval_CallObjectWithKeywords`
* :c:func:`PyEval_EvalCode`
* :c:func:`PyEval_EvalCodeEx`
* :c:func:`PyEval_EvalFrame`
* :c:func:`PyEval_EvalFrameEx`
* :c:func:`PyEval_GetBuiltins`
* :c:func:`PyEval_GetFrame`
* :c:func:`PyEval_GetFuncDesc`
* :c:func:`PyEval_GetFuncName`
* :c:func:`PyEval_GetGlobals`
* :c:func:`PyEval_GetLocals`
* :c:func:`PyEval_InitThreads`
* :c:func:`PyEval_ReleaseLock`
* :c:func:`PyEval_ReleaseThread`
* :c:func:`PyEval_RestoreThread`
* :c:func:`PyEval_SaveThread`
* :c:func:`PyEval_ThreadsInitialized`
* :c:data:`PyExc_ArithmeticError`
* :c:data:`PyExc_AssertionError`
* :c:data:`PyExc_AttributeError`
* :c:data:`PyExc_BaseException`
* :c:data:`PyExc_BlockingIOError`
* :c:data:`PyExc_BrokenPipeError`
* :c:data:`PyExc_BufferError`
* :c:data:`PyExc_BytesWarning`
* :c:data:`PyExc_ChildProcessError`
* :c:data:`PyExc_ConnectionAbortedError`
* :c:data:`PyExc_ConnectionError`
* :c:data:`PyExc_ConnectionRefusedError`
* :c:data:`PyExc_ConnectionResetError`
* :c:data:`PyExc_DeprecationWarning`
* :c:data:`PyExc_EOFError`
* :c:data:`PyExc_EncodingWarning`
* :c:data:`PyExc_EnvironmentError`
* :c:data:`PyExc_Exception`
* :c:data:`PyExc_FileExistsError`
* :c:data:`PyExc_FileNotFoundError`
* :c:data:`PyExc_FloatingPointError`
* :c:data:`PyExc_FutureWarning`
* :c:data:`PyExc_GeneratorExit`
* :c:data:`PyExc_IOError`
* :c:data:`PyExc_ImportError`
* :c:data:`PyExc_ImportWarning`
* :c:data:`PyExc_IndentationError`
* :c:data:`PyExc_IndexError`
* :c:data:`PyExc_InterruptedError`
* :c:data:`PyExc_IsADirectoryError`
* :c:data:`PyExc_KeyError`
* :c:data:`PyExc_KeyboardInterrupt`
* :c:data:`PyExc_LookupError`
* :c:data:`PyExc_MemoryError`
* :c:data:`PyExc_ModuleNotFoundError`
* :c:data:`PyExc_NameError`
* :c:data:`PyExc_NotADirectoryError`
* :c:data:`PyExc_NotImplementedError`
* :c:data:`PyExc_OSError`
* :c:data:`PyExc_OverflowError`
* :c:data:`PyExc_PendingDeprecationWarning`
* :c:data:`PyExc_PermissionError`
* :c:data:`PyExc_ProcessLookupError`
* :c:data:`PyExc_RecursionError`
* :c:data:`PyExc_ReferenceError`
* :c:data:`PyExc_ResourceWarning`
* :c:data:`PyExc_RuntimeError`
* :c:data:`PyExc_RuntimeWarning`
* :c:data:`PyExc_StopAsyncIteration`
* :c:data:`PyExc_StopIteration`
* :c:data:`PyExc_SyntaxError`
* :c:data:`PyExc_SyntaxWarning`
* :c:data:`PyExc_SystemError`
* :c:data:`PyExc_SystemExit`
* :c:data:`PyExc_TabError`
* :c:data:`PyExc_TimeoutError`
* :c:data:`PyExc_TypeError`
* :c:data:`PyExc_UnboundLocalError`
* :c:data:`PyExc_UnicodeDecodeError`
* :c:data:`PyExc_UnicodeEncodeError`
* :c:data:`PyExc_UnicodeError`
* :c:data:`PyExc_UnicodeTranslateError`
* :c:data:`PyExc_UnicodeWarning`
* :c:data:`PyExc_UserWarning`
* :c:data:`PyExc_ValueError`
* :c:data:`PyExc_Warning`
* :c:data:`PyExc_WindowsError`
* :c:data:`PyExc_ZeroDivisionError`
* :c:func:`PyExceptionClass_Name`
* :c:func:`PyException_GetCause`
* :c:func:`PyException_GetContext`
* :c:func:`PyException_GetTraceback`
* :c:func:`PyException_SetCause`
* :c:func:`PyException_SetContext`
* :c:func:`PyException_SetTraceback`
* :c:func:`PyFile_FromFd`
* :c:func:`PyFile_GetLine`
* :c:func:`PyFile_WriteObject`
* :c:func:`PyFile_WriteString`
* :c:data:`PyFilter_Type`
* :c:func:`PyFloat_AsDouble`
* :c:func:`PyFloat_FromDouble`
* :c:func:`PyFloat_FromString`
* :c:func:`PyFloat_GetInfo`
* :c:func:`PyFloat_GetMax`
* :c:func:`PyFloat_GetMin`
* :c:data:`PyFloat_Type`
* :c:func:`PyFrame_GetCode`
* :c:func:`PyFrame_GetLineNumber`
* :c:func:`PyFrozenSet_New`
* :c:data:`PyFrozenSet_Type`
* :c:func:`PyGC_Collect`
* :c:func:`PyGC_Disable`
* :c:func:`PyGC_Enable`
* :c:func:`PyGC_IsEnabled`
* :c:func:`PyGILState_Ensure`
* :c:func:`PyGILState_GetThisThreadState`
* :c:func:`PyGILState_Release`
* :c:type:`PyGILState_STATE`
* :c:type:`PyGetSetDef`
* :c:data:`PyGetSetDescr_Type`
* :c:func:`PyImport_AddModule`
* :c:func:`PyImport_AddModuleObject`
* :c:func:`PyImport_AppendInittab`
* :c:func:`PyImport_ExecCodeModule`
* :c:func:`PyImport_ExecCodeModuleEx`
* :c:func:`PyImport_ExecCodeModuleObject`
* :c:func:`PyImport_ExecCodeModuleWithPathnames`
* :c:func:`PyImport_GetImporter`
* :c:func:`PyImport_GetMagicNumber`
* :c:func:`PyImport_GetMagicTag`
* :c:func:`PyImport_GetModule`
* :c:func:`PyImport_GetModuleDict`
* :c:func:`PyImport_Import`
* :c:func:`PyImport_ImportFrozenModule`
* :c:func:`PyImport_ImportFrozenModuleObject`
* :c:func:`PyImport_ImportModule`
* :c:func:`PyImport_ImportModuleLevel`
* :c:func:`PyImport_ImportModuleLevelObject`
* :c:func:`PyImport_ImportModuleNoBlock`
* :c:func:`PyImport_ReloadModule`
* :c:func:`PyIndex_Check`
* :c:type:`PyInterpreterState`
* :c:func:`PyInterpreterState_Clear`
* :c:func:`PyInterpreterState_Delete`
* :c:func:`PyInterpreterState_Get`
* :c:func:`PyInterpreterState_GetDict`
* :c:func:`PyInterpreterState_GetID`
* :c:func:`PyInterpreterState_New`
* :c:func:`PyIter_Check`
* :c:func:`PyIter_Next`
* :c:func:`PyIter_Send`
* :c:data:`PyListIter_Type`
* :c:data:`PyListRevIter_Type`
* :c:func:`PyList_Append`
* :c:func:`PyList_AsTuple`
* :c:func:`PyList_GetItem`
* :c:func:`PyList_GetSlice`
* :c:func:`PyList_Insert`
* :c:func:`PyList_New`
* :c:func:`PyList_Reverse`
* :c:func:`PyList_SetItem`
* :c:func:`PyList_SetSlice`
* :c:func:`PyList_Size`
* :c:func:`PyList_Sort`
* :c:data:`PyList_Type`
* :c:type:`PyLongObject`
* :c:data:`PyLongRangeIter_Type`
* :c:func:`PyLong_AsDouble`
* :c:func:`PyLong_AsLong`
* :c:func:`PyLong_AsLongAndOverflow`
* :c:func:`PyLong_AsLongLong`
* :c:func:`PyLong_AsLongLongAndOverflow`
* :c:func:`PyLong_AsSize_t`
* :c:func:`PyLong_AsSsize_t`
* :c:func:`PyLong_AsUnsignedLong`
* :c:func:`PyLong_AsUnsignedLongLong`
* :c:func:`PyLong_AsUnsignedLongLongMask`
* :c:func:`PyLong_AsUnsignedLongMask`
* :c:func:`PyLong_AsVoidPtr`
* :c:func:`PyLong_FromDouble`
* :c:func:`PyLong_FromLong`
* :c:func:`PyLong_FromLongLong`
* :c:func:`PyLong_FromSize_t`
* :c:func:`PyLong_FromSsize_t`
* :c:func:`PyLong_FromString`
* :c:func:`PyLong_FromUnsignedLong`
* :c:func:`PyLong_FromUnsignedLongLong`
* :c:func:`PyLong_FromVoidPtr`
* :c:func:`PyLong_GetInfo`
* :c:data:`PyLong_Type`
* :c:data:`PyMap_Type`
* :c:func:`PyMapping_Check`
* :c:func:`PyMapping_GetItemString`
* :c:func:`PyMapping_HasKey`
* :c:func:`PyMapping_HasKeyString`
* :c:func:`PyMapping_Items`
* :c:func:`PyMapping_Keys`
* :c:func:`PyMapping_Length`
* :c:func:`PyMapping_SetItemString`
* :c:func:`PyMapping_Size`
* :c:func:`PyMapping_Values`
* :c:func:`PyMem_Calloc`
* :c:func:`PyMem_Free`
* :c:func:`PyMem_Malloc`
* :c:func:`PyMem_Realloc`
* :c:type:`PyMemberDef`
* :c:data:`PyMemberDescr_Type`
* :c:func:`PyMemoryView_FromMemory`
* :c:func:`PyMemoryView_FromObject`
* :c:func:`PyMemoryView_GetContiguous`
* :c:data:`PyMemoryView_Type`
* :c:type:`PyMethodDef`
* :c:data:`PyMethodDescr_Type`
* :c:type:`PyModuleDef`
* :c:type:`PyModuleDef_Base`
* :c:func:`PyModuleDef_Init`
* :c:data:`PyModuleDef_Type`
* :c:func:`PyModule_AddFunctions`
* :c:func:`PyModule_AddIntConstant`
* :c:func:`PyModule_AddObject`
* :c:func:`PyModule_AddObjectRef`
* :c:func:`PyModule_AddStringConstant`
* :c:func:`PyModule_AddType`
* :c:func:`PyModule_Create2`
* :c:func:`PyModule_ExecDef`
* :c:func:`PyModule_FromDefAndSpec2`
* :c:func:`PyModule_GetDef`
* :c:func:`PyModule_GetDict`
* :c:func:`PyModule_GetFilename`
* :c:func:`PyModule_GetFilenameObject`
* :c:func:`PyModule_GetName`
* :c:func:`PyModule_GetNameObject`
* :c:func:`PyModule_GetState`
* :c:func:`PyModule_New`
* :c:func:`PyModule_NewObject`
* :c:func:`PyModule_SetDocString`
* :c:data:`PyModule_Type`
* :c:func:`PyNumber_Absolute`
* :c:func:`PyNumber_Add`
* :c:func:`PyNumber_And`
* :c:func:`PyNumber_AsSsize_t`
* :c:func:`PyNumber_Check`
* :c:func:`PyNumber_Divmod`
* :c:func:`PyNumber_Float`
* :c:func:`PyNumber_FloorDivide`
* :c:func:`PyNumber_InPlaceAdd`
* :c:func:`PyNumber_InPlaceAnd`
* :c:func:`PyNumber_InPlaceFloorDivide`
* :c:func:`PyNumber_InPlaceLshift`
* :c:func:`PyNumber_InPlaceMatrixMultiply`
* :c:func:`PyNumber_InPlaceMultiply`
* :c:func:`PyNumber_InPlaceOr`
* :c:func:`PyNumber_InPlacePower`
* :c:func:`PyNumber_InPlaceRemainder`
* :c:func:`PyNumber_InPlaceRshift`
* :c:func:`PyNumber_InPlaceSubtract`
* :c:func:`PyNumber_InPlaceTrueDivide`
* :c:func:`PyNumber_InPlaceXor`
* :c:func:`PyNumber_Index`
* :c:func:`PyNumber_Invert`
* :c:func:`PyNumber_Long`
* :c:func:`PyNumber_Lshift`
* :c:func:`PyNumber_MatrixMultiply`
* :c:func:`PyNumber_Multiply`
* :c:func:`PyNumber_Negative`
* :c:func:`PyNumber_Or`
* :c:func:`PyNumber_Positive`
* :c:func:`PyNumber_Power`
* :c:func:`PyNumber_Remainder`
* :c:func:`PyNumber_Rshift`
* :c:func:`PyNumber_Subtract`
* :c:func:`PyNumber_ToBase`
* :c:func:`PyNumber_TrueDivide`
* :c:func:`PyNumber_Xor`
* :c:func:`PyOS_AfterFork`
* :c:func:`PyOS_AfterFork_Child`
* :c:func:`PyOS_AfterFork_Parent`
* :c:func:`PyOS_BeforeFork`
* :c:func:`PyOS_CheckStack`
* :c:func:`PyOS_FSPath`
* :c:data:`PyOS_InputHook`
* :c:func:`PyOS_InterruptOccurred`
* :c:func:`PyOS_double_to_string`
* :c:func:`PyOS_getsig`
* :c:func:`PyOS_mystricmp`
* :c:func:`PyOS_mystrnicmp`
* :c:func:`PyOS_setsig`
* :c:type:`PyOS_sighandler_t`
* :c:func:`PyOS_snprintf`
* :c:func:`PyOS_string_to_double`
* :c:func:`PyOS_strtol`
* :c:func:`PyOS_strtoul`
* :c:func:`PyOS_vsnprintf`
* :c:type:`PyObject`
* :c:func:`PyObject_ASCII`
* :c:func:`PyObject_AsFileDescriptor`
* :c:func:`PyObject_Bytes`
* :c:func:`PyObject_Call`
* :c:func:`PyObject_CallFunction`
* :c:func:`PyObject_CallFunctionObjArgs`
* :c:func:`PyObject_CallMethod`
* :c:func:`PyObject_CallMethodObjArgs`
* :c:func:`PyObject_CallNoArgs`
* :c:func:`PyObject_CallObject`
* :c:func:`PyObject_Calloc`
* :c:func:`PyObject_ClearWeakRefs`
* :c:func:`PyObject_DelItem`
* :c:func:`PyObject_DelItemString`
* :c:func:`PyObject_Dir`
* :c:func:`PyObject_Format`
* :c:func:`PyObject_Free`
* :c:func:`PyObject_GC_Del`
* :c:func:`PyObject_GC_IsFinalized`
* :c:func:`PyObject_GC_IsTracked`
* :c:func:`PyObject_GC_Track`
* :c:func:`PyObject_GC_UnTrack`
* :c:func:`PyObject_GenericGetAttr`
* :c:func:`PyObject_GenericGetDict`
* :c:func:`PyObject_GenericSetAttr`
* :c:func:`PyObject_GenericSetDict`
* :c:func:`PyObject_GetAiter`
* :c:func:`PyObject_GetAttr`
* :c:func:`PyObject_GetAttrString`
* :c:func:`PyObject_GetItem`
* :c:func:`PyObject_GetIter`
* :c:func:`PyObject_HasAttr`
* :c:func:`PyObject_HasAttrString`
* :c:func:`PyObject_Hash`
* :c:func:`PyObject_HashNotImplemented`
* :c:func:`PyObject_Init`
* :c:func:`PyObject_InitVar`
* :c:func:`PyObject_IsInstance`
* :c:func:`PyObject_IsSubclass`
* :c:func:`PyObject_IsTrue`
* :c:func:`PyObject_Length`
* :c:func:`PyObject_Malloc`
* :c:func:`PyObject_Not`
* :c:func:`PyObject_Realloc`
* :c:func:`PyObject_Repr`
* :c:func:`PyObject_RichCompare`
* :c:func:`PyObject_RichCompareBool`
* :c:func:`PyObject_SelfIter`
* :c:func:`PyObject_SetAttr`
* :c:func:`PyObject_SetAttrString`
* :c:func:`PyObject_SetItem`
* :c:func:`PyObject_Size`
* :c:func:`PyObject_Str`
* :c:func:`PyObject_Type`
* :c:data:`PyProperty_Type`
* :c:data:`PyRangeIter_Type`
* :c:data:`PyRange_Type`
* :c:data:`PyReversed_Type`
* :c:func:`PySeqIter_New`
* :c:data:`PySeqIter_Type`
* :c:func:`PySequence_Check`
* :c:func:`PySequence_Concat`
* :c:func:`PySequence_Contains`
* :c:func:`PySequence_Count`
* :c:func:`PySequence_DelItem`
* :c:func:`PySequence_DelSlice`
* :c:func:`PySequence_Fast`
* :c:func:`PySequence_GetItem`
* :c:func:`PySequence_GetSlice`
* :c:func:`PySequence_In`
* :c:func:`PySequence_InPlaceConcat`
* :c:func:`PySequence_InPlaceRepeat`
* :c:func:`PySequence_Index`
* :c:func:`PySequence_Length`
* :c:func:`PySequence_List`
* :c:func:`PySequence_Repeat`
* :c:func:`PySequence_SetItem`
* :c:func:`PySequence_SetSlice`
* :c:func:`PySequence_Size`
* :c:func:`PySequence_Tuple`
* :c:data:`PySetIter_Type`
* :c:func:`PySet_Add`
* :c:func:`PySet_Clear`
* :c:func:`PySet_Contains`
* :c:func:`PySet_Discard`
* :c:func:`PySet_New`
* :c:func:`PySet_Pop`
* :c:func:`PySet_Size`
* :c:data:`PySet_Type`
* :c:func:`PySlice_AdjustIndices`
* :c:func:`PySlice_GetIndices`
* :c:func:`PySlice_GetIndicesEx`
* :c:func:`PySlice_New`
* :c:data:`PySlice_Type`
* :c:func:`PySlice_Unpack`
* :c:func:`PyState_AddModule`
* :c:func:`PyState_FindModule`
* :c:func:`PyState_RemoveModule`
* :c:type:`PyStructSequence_Desc`
* :c:type:`PyStructSequence_Field`
* :c:func:`PyStructSequence_GetItem`
* :c:func:`PyStructSequence_New`
* :c:func:`PyStructSequence_NewType`
* :c:func:`PyStructSequence_SetItem`
* :c:data:`PySuper_Type`
* :c:func:`PySys_AddWarnOption`
* :c:func:`PySys_AddWarnOptionUnicode`
* :c:func:`PySys_AddXOption`
* :c:func:`PySys_FormatStderr`
* :c:func:`PySys_FormatStdout`
* :c:func:`PySys_GetObject`
* :c:func:`PySys_GetXOptions`
* :c:func:`PySys_HasWarnOptions`
* :c:func:`PySys_ResetWarnOptions`
* :c:func:`PySys_SetArgv`
* :c:func:`PySys_SetArgvEx`
* :c:func:`PySys_SetObject`
* :c:func:`PySys_SetPath`
* :c:func:`PySys_WriteStderr`
* :c:func:`PySys_WriteStdout`
* :c:type:`PyThreadState`
* :c:func:`PyThreadState_Clear`
* :c:func:`PyThreadState_Delete`
* :c:func:`PyThreadState_Get`
* :c:func:`PyThreadState_GetDict`
* :c:func:`PyThreadState_GetFrame`
* :c:func:`PyThreadState_GetID`
* :c:func:`PyThreadState_GetInterpreter`
* :c:func:`PyThreadState_New`
* :c:func:`PyThreadState_SetAsyncExc`
* :c:func:`PyThreadState_Swap`
* :c:func:`PyThread_GetInfo`
* :c:func:`PyThread_ReInitTLS`
* :c:func:`PyThread_acquire_lock`
* :c:func:`PyThread_acquire_lock_timed`
* :c:func:`PyThread_allocate_lock`
* :c:func:`PyThread_create_key`
* :c:func:`PyThread_delete_key`
* :c:func:`PyThread_delete_key_value`
* :c:func:`PyThread_exit_thread`
* :c:func:`PyThread_free_lock`
* :c:func:`PyThread_get_key_value`
* :c:func:`PyThread_get_stacksize`
* :c:func:`PyThread_get_thread_ident`
* :c:func:`PyThread_get_thread_native_id`
* :c:func:`PyThread_init_thread`
* :c:func:`PyThread_release_lock`
* :c:func:`PyThread_set_key_value`
* :c:func:`PyThread_set_stacksize`
* :c:func:`PyThread_start_new_thread`
* :c:func:`PyThread_tss_alloc`
* :c:func:`PyThread_tss_create`
* :c:func:`PyThread_tss_delete`
* :c:func:`PyThread_tss_free`
* :c:func:`PyThread_tss_get`
* :c:func:`PyThread_tss_is_created`
* :c:func:`PyThread_tss_set`
* :c:func:`PyTraceBack_Here`
* :c:func:`PyTraceBack_Print`
* :c:data:`PyTraceBack_Type`
* :c:data:`PyTupleIter_Type`
* :c:func:`PyTuple_GetItem`
* :c:func:`PyTuple_GetSlice`
* :c:func:`PyTuple_New`
* :c:func:`PyTuple_Pack`
* :c:func:`PyTuple_SetItem`
* :c:func:`PyTuple_Size`
* :c:data:`PyTuple_Type`
* :c:type:`PyTypeObject`
* :c:func:`PyType_ClearCache`
* :c:func:`PyType_FromModuleAndSpec`
* :c:func:`PyType_FromSpec`
* :c:func:`PyType_FromSpecWithBases`
* :c:func:`PyType_GenericAlloc`
* :c:func:`PyType_GenericNew`
* :c:func:`PyType_GetFlags`
* :c:func:`PyType_GetModule`
* :c:func:`PyType_GetModuleState`
* :c:func:`PyType_GetSlot`
* :c:func:`PyType_IsSubtype`
* :c:func:`PyType_Modified`
* :c:func:`PyType_Ready`
* :c:type:`PyType_Slot`
* :c:type:`PyType_Spec`
* :c:data:`PyType_Type`
* :c:func:`PyUnicodeDecodeError_Create`
* :c:func:`PyUnicodeDecodeError_GetEncoding`
* :c:func:`PyUnicodeDecodeError_GetEnd`
* :c:func:`PyUnicodeDecodeError_GetObject`
* :c:func:`PyUnicodeDecodeError_GetReason`
* :c:func:`PyUnicodeDecodeError_GetStart`
* :c:func:`PyUnicodeDecodeError_SetEnd`
* :c:func:`PyUnicodeDecodeError_SetReason`
* :c:func:`PyUnicodeDecodeError_SetStart`
* :c:func:`PyUnicodeEncodeError_GetEncoding`
* :c:func:`PyUnicodeEncodeError_GetEnd`
* :c:func:`PyUnicodeEncodeError_GetObject`
* :c:func:`PyUnicodeEncodeError_GetReason`
* :c:func:`PyUnicodeEncodeError_GetStart`
* :c:func:`PyUnicodeEncodeError_SetEnd`
* :c:func:`PyUnicodeEncodeError_SetReason`
* :c:func:`PyUnicodeEncodeError_SetStart`
* :c:data:`PyUnicodeIter_Type`
* :c:func:`PyUnicodeTranslateError_GetEnd`
* :c:func:`PyUnicodeTranslateError_GetObject`
* :c:func:`PyUnicodeTranslateError_GetReason`
* :c:func:`PyUnicodeTranslateError_GetStart`
* :c:func:`PyUnicodeTranslateError_SetEnd`
* :c:func:`PyUnicodeTranslateError_SetReason`
* :c:func:`PyUnicodeTranslateError_SetStart`
* :c:func:`PyUnicode_Append`
* :c:func:`PyUnicode_AppendAndDel`
* :c:func:`PyUnicode_AsASCIIString`
* :c:func:`PyUnicode_AsCharmapString`
* :c:func:`PyUnicode_AsDecodedObject`
* :c:func:`PyUnicode_AsDecodedUnicode`
* :c:func:`PyUnicode_AsEncodedObject`
* :c:func:`PyUnicode_AsEncodedString`
* :c:func:`PyUnicode_AsEncodedUnicode`
* :c:func:`PyUnicode_AsLatin1String`
* :c:func:`PyUnicode_AsMBCSString`
* :c:func:`PyUnicode_AsRawUnicodeEscapeString`
* :c:func:`PyUnicode_AsUCS4`
* :c:func:`PyUnicode_AsUCS4Copy`
* :c:func:`PyUnicode_AsUTF16String`
* :c:func:`PyUnicode_AsUTF32String`
* :c:func:`PyUnicode_AsUTF8AndSize`
* :c:func:`PyUnicode_AsUTF8String`
* :c:func:`PyUnicode_AsUnicodeEscapeString`
* :c:func:`PyUnicode_AsWideChar`
* :c:func:`PyUnicode_AsWideCharString`
* :c:func:`PyUnicode_BuildEncodingMap`
* :c:func:`PyUnicode_Compare`
* :c:func:`PyUnicode_CompareWithASCIIString`
* :c:func:`PyUnicode_Concat`
* :c:func:`PyUnicode_Contains`
* :c:func:`PyUnicode_Count`
* :c:func:`PyUnicode_Decode`
* :c:func:`PyUnicode_DecodeASCII`
* :c:func:`PyUnicode_DecodeCharmap`
* :c:func:`PyUnicode_DecodeCodePageStateful`
* :c:func:`PyUnicode_DecodeFSDefault`
* :c:func:`PyUnicode_DecodeFSDefaultAndSize`
* :c:func:`PyUnicode_DecodeLatin1`
* :c:func:`PyUnicode_DecodeLocale`
* :c:func:`PyUnicode_DecodeLocaleAndSize`
* :c:func:`PyUnicode_DecodeMBCS`
* :c:func:`PyUnicode_DecodeMBCSStateful`
* :c:func:`PyUnicode_DecodeRawUnicodeEscape`
* :c:func:`PyUnicode_DecodeUTF16`
* :c:func:`PyUnicode_DecodeUTF16Stateful`
* :c:func:`PyUnicode_DecodeUTF32`
* :c:func:`PyUnicode_DecodeUTF32Stateful`
* :c:func:`PyUnicode_DecodeUTF7`
* :c:func:`PyUnicode_DecodeUTF7Stateful`
* :c:func:`PyUnicode_DecodeUTF8`
* :c:func:`PyUnicode_DecodeUTF8Stateful`
* :c:func:`PyUnicode_DecodeUnicodeEscape`
* :c:func:`PyUnicode_EncodeCodePage`
* :c:func:`PyUnicode_EncodeFSDefault`
* :c:func:`PyUnicode_EncodeLocale`
* :c:func:`PyUnicode_FSConverter`
* :c:func:`PyUnicode_FSDecoder`
* :c:func:`PyUnicode_Find`
* :c:func:`PyUnicode_FindChar`
* :c:func:`PyUnicode_Format`
* :c:func:`PyUnicode_FromEncodedObject`
* :c:func:`PyUnicode_FromFormat`
* :c:func:`PyUnicode_FromFormatV`
* :c:func:`PyUnicode_FromObject`
* :c:func:`PyUnicode_FromOrdinal`
* :c:func:`PyUnicode_FromString`
* :c:func:`PyUnicode_FromStringAndSize`
* :c:func:`PyUnicode_FromWideChar`
* :c:func:`PyUnicode_GetDefaultEncoding`
* :c:func:`PyUnicode_GetLength`
* :c:func:`PyUnicode_GetSize`
* :c:func:`PyUnicode_InternFromString`
* :c:func:`PyUnicode_InternImmortal`
* :c:func:`PyUnicode_InternInPlace`
* :c:func:`PyUnicode_IsIdentifier`
* :c:func:`PyUnicode_Join`
* :c:func:`PyUnicode_Partition`
* :c:func:`PyUnicode_RPartition`
* :c:func:`PyUnicode_RSplit`
* :c:func:`PyUnicode_ReadChar`
* :c:func:`PyUnicode_Replace`
* :c:func:`PyUnicode_Resize`
* :c:func:`PyUnicode_RichCompare`
* :c:func:`PyUnicode_Split`
* :c:func:`PyUnicode_Splitlines`
* :c:func:`PyUnicode_Substring`
* :c:func:`PyUnicode_Tailmatch`
* :c:func:`PyUnicode_Translate`
* :c:data:`PyUnicode_Type`
* :c:func:`PyUnicode_WriteChar`
* :c:type:`PyVarObject`
* :c:type:`PyWeakReference`
* :c:func:`PyWeakref_GetObject`
* :c:func:`PyWeakref_NewProxy`
* :c:func:`PyWeakref_NewRef`
* :c:data:`PyWrapperDescr_Type`
* :c:func:`PyWrapper_New`
* :c:data:`PyZip_Type`
* :c:func:`Py_AddPendingCall`
* :c:func:`Py_AtExit`
* :c:macro:`Py_BEGIN_ALLOW_THREADS`
* :c:macro:`Py_BLOCK_THREADS`
* :c:func:`Py_BuildValue`
* :c:func:`Py_BytesMain`
* :c:func:`Py_CompileString`
* :c:func:`Py_DecRef`
* :c:func:`Py_DecodeLocale`
* :c:macro:`Py_END_ALLOW_THREADS`
* :c:func:`Py_EncodeLocale`
* :c:func:`Py_EndInterpreter`
* :c:func:`Py_EnterRecursiveCall`
* :c:func:`Py_Exit`
* :c:func:`Py_FatalError`
* :c:data:`Py_FileSystemDefaultEncodeErrors`
* :c:data:`Py_FileSystemDefaultEncoding`
* :c:func:`Py_Finalize`
* :c:func:`Py_FinalizeEx`
* :c:func:`Py_FrozenMain`
* :c:func:`Py_GenericAlias`
* :c:func:`Py_GenericAliasType`
* :c:func:`Py_GetBuildInfo`
* :c:func:`Py_GetCompiler`
* :c:func:`Py_GetCopyright`
* :c:func:`Py_GetExecPrefix`
* :c:func:`Py_GetPath`
* :c:func:`Py_GetPlatform`
* :c:func:`Py_GetPrefix`
* :c:func:`Py_GetProgramFullPath`
* :c:func:`Py_GetProgramName`
* :c:func:`Py_GetPythonHome`
* :c:func:`Py_GetRecursionLimit`
* :c:func:`Py_GetVersion`
* :c:data:`Py_HasFileSystemDefaultEncoding`
* :c:func:`Py_IncRef`
* :c:func:`Py_Initialize`
* :c:func:`Py_InitializeEx`
* :c:func:`Py_Is`
* :c:func:`Py_IsFalse`
* :c:func:`Py_IsInitialized`
* :c:func:`Py_IsNone`
* :c:func:`Py_IsTrue`
* :c:func:`Py_LeaveRecursiveCall`
* :c:func:`Py_Main`
* :c:func:`Py_MakePendingCalls`
* :c:func:`Py_NewInterpreter`
* :c:func:`Py_NewRef`
* :c:func:`Py_ReprEnter`
* :c:func:`Py_ReprLeave`
* :c:func:`Py_SetPath`
* :c:func:`Py_SetProgramName`
* :c:func:`Py_SetPythonHome`
* :c:func:`Py_SetRecursionLimit`
* :c:type:`Py_UCS4`
* :c:macro:`Py_UNBLOCK_THREADS`
* :c:data:`Py_UTF8Mode`
* :c:func:`Py_VaBuildValue`
* :c:func:`Py_XNewRef`
* :c:type:`Py_intptr_t`
* :c:type:`Py_ssize_t`
* :c:type:`Py_uintptr_t`
* :c:type:`_frame`
* :c:type:`_node`
* :c:type:`allocfunc`
* :c:type:`binaryfunc`
* :c:type:`descrgetfunc`
* :c:type:`descrsetfunc`
* :c:type:`destructor`
* :c:type:`getattrfunc`
* :c:type:`getattrofunc`
* :c:type:`getiterfunc`
* :c:type:`getter`
* :c:type:`hashfunc`
* :c:type:`initproc`
* :c:type:`inquiry`
* :c:type:`iternextfunc`
* :c:type:`lenfunc`
* :c:type:`newfunc`
* :c:type:`objobjargproc`
* :c:type:`objobjproc`
* :c:type:`reprfunc`
* :c:type:`richcmpfunc`
* :c:type:`setattrfunc`
* :c:type:`setattrofunc`
* :c:type:`setter`
* :c:type:`ssizeargfunc`
* :c:type:`ssizeobjargproc`
* :c:type:`ssizessizeargfunc`
* :c:type:`ssizessizeobjargproc`
* :c:type:`symtable`
* :c:type:`ternaryfunc`
* :c:type:`traverseproc`
* :c:type:`unaryfunc`
* :c:type:`visitproc`
