.. Auto-generated by Tools/build/generate_token.py

.. list-table::
   :align: left
   :header-rows: 1

   * - Token
     - Value
   * - .. data:: LPAR
     - ``"("``
   * - .. data:: RPAR
     - ``")"``
   * - .. data:: LSQB
     - ``"["``
   * - .. data:: RSQB
     - ``"]"``
   * - .. data:: COLON
     - ``":"``
   * - .. data:: COMMA
     - ``","``
   * - .. data:: SEMI
     - ``";"``
   * - .. data:: PLUS
     - ``"+"``
   * - .. data:: MINUS
     - ``"-"``
   * - .. data:: STAR
     - ``"*"``
   * - .. data:: SLASH
     - ``"/"``
   * - .. data:: VBAR
     - ``"|"``
   * - .. data:: AMPER
     - ``"&"``
   * - .. data:: LESS
     - ``"<"``
   * - .. data:: GREATER
     - ``">"``
   * - .. data:: EQUAL
     - ``"="``
   * - .. data:: DOT
     - ``"."``
   * - .. data:: PERCENT
     - ``"%"``
   * - .. data:: LBRACE
     - ``"{"``
   * - .. data:: RBRACE
     - ``"}"``
   * - .. data:: EQEQUAL
     - ``"=="``
   * - .. data:: NOTEQUAL
     - ``"!="``
   * - .. data:: LESSEQUAL
     - ``"<="``
   * - .. data:: GREATEREQUAL
     - ``">="``
   * - .. data:: TILDE
     - ``"~"``
   * - .. data:: CIRCUMFLEX
     - ``"^"``
   * - .. data:: LEFTSHIFT
     - ``"<<"``
   * - .. data:: RIGHTSHIFT
     - ``">>"``
   * - .. data:: DOUBLESTAR
     - ``"**"``
   * - .. data:: PLUSEQUAL
     - ``"+="``
   * - .. data:: MINEQUAL
     - ``"-="``
   * - .. data:: STAREQUAL
     - ``"*="``
   * - .. data:: SLASHEQUAL
     - ``"/="``
   * - .. data:: PERCENTEQUAL
     - ``"%="``
   * - .. data:: AMPEREQUAL
     - ``"&="``
   * - .. data:: VBAREQUAL
     - ``"|="``
   * - .. data:: CIRCUMFLEXEQUAL
     - ``"^="``
   * - .. data:: LEFTSHIFTEQUAL
     - ``"<<="``
   * - .. data:: RIGHTSHIFTEQUAL
     - ``">>="``
   * - .. data:: DOUBLESTAREQUAL
     - ``"**="``
   * - .. data:: DOUBLESLASH
     - ``"//"``
   * - .. data:: DOUBLESLASHEQUAL
     - ``"//="``
   * - .. data:: AT
     - ``"@"``
   * - .. data:: ATEQUAL
     - ``"@="``
   * - .. data:: RARROW
     - ``"->"``
   * - .. data:: ELLIPSIS
     - ``"..."``
   * - .. data:: COLONEQUAL
     - ``":="``
   * - .. data:: EXCLAMATION
     - ``"!"``
